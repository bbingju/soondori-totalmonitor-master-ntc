#include "0_SensorCal.h"



/*********************************************************************
*	pTableNTC
*	NTC 10KR 에 대한 환산용 테이블 
**********************************************************************/	
#ifndef __P_TABLE_NTC__
#define __P_TABLE_NTC__

uint32_t pTableNTC[161] = {
	3482, 3452, 3422, 3391, 3359, 3325, 3291, 3257, 3221, 3184, 	// -10 ~	-1 [째C]
	3146, 														//	 0
	3108, 3069, 3028, 2987, 2947, 2903, 2861, 2818, 2775, 2732, 	//	 1 ~	10
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		97, 	95, 	92, 	90, 	88, 	86, 	85, 	83, 	81, 	79		// 141 ~ 150
};
#endif

/*********************************************************************
*	pTableRTD
*	RTD PT100 에 대한 환산용 테이블 
**********************************************************************/	
#ifndef __P_TABLE_RTD__
#define __P_TABLE_RTD__

uint32_t pTableRTD[161] = {
	1745, 1752, 1758, 1764, 1770, 1777, 1783, 1790, 1796, 1802, 	// -10 ~	-1 [째C]
	1808, 																
	1815, 1821, 1827, 1833, 1840, 1846, 1852, 1858, 1865, 1871, 	//	 1 ~	10
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	2628, 2633, 2638, 2644, 2649, 2654, 2660, 2665, 2670, 2676		// 141 ~ 150
};

#endif


/*********************************************************************
*	Calc_BD_Temp
*	ETH-01DV 온도 변환 함수 
* 	val : ADC 값을 입력 
**********************************************************************/
float Calc_BD_Temp(uint32_t val)
{
	return (float)val * 165 / 4096 - 40;		// 째C = Vout[12bit=4096] / (Vin=5[V] / 165) - 40
}

/*********************************************************************
*	Calc_BD_Humi
*	ETH-01DV 습도 변환 함수 
* 	val : ADC 값을 입력 
**********************************************************************/
float Calc_BD_Humi(uint32_t val)
{
//			return (double)val * 100 / 4096;			// %RH = Vout[12bit=4096] / (Vin=5[V] / 100)
	return (float)val * 125 / 4096 - 12.5;
}

/*********************************************************************
*	Calc_Temp_NTC
*	NTC 온도 변환 함수 
* 	val : ADC 값을 입력, TABLE 중간 값을 보간하여 표시 
**********************************************************************/
float Calc_Temp_NTC(uint32_t val)
{
	int i;

	if ((val == 0) || (val > pTableNTC[0]) || (val < pTableNTC[160])){
		return 0;

	}

	for (i = 0; i < 161; i++){
		if (pTableNTC[i] < val){
			break;
		}
	}
	
	if (i == 0){
		return 0;
	}
	
	float dv = (float) val;
	float d1 = (float) pTableNTC[i - 1];
	float d2 = (float) pTableNTC[i];
	
	return (dv - d1) / (d2 - d1) + i - 11;
}

/*********************************************************************
*	Calc_Temp_RTD
*	RTC 온도 변환 함수 
* 	val : ADC 값을 입력, TABLE 중간 값을 보간하여 표시 
**********************************************************************/
float Calc_Temp_RTD(uint32_t val)
{
	float dv;
	float d1;
	float d2;
    float res = 0;
	int i;
	
	if ((val == 0) || (val < pTableRTD[0]) || (val > pTableRTD[160])){
		return 0;
	}
	
	for (i = 0; i < 161; i++)	{
		if (pTableRTD[i] > val){
			break;
		}
	}
	
	if (i == 0){
		return 0;
	}
	
	dv = (float)val;
	d1 = (float)pTableRTD[i - 1];
	d2 = (float)pTableRTD[i];
	
	res = (dv - d1) / (d2 - d1) + i - 11;
    return res;
}
